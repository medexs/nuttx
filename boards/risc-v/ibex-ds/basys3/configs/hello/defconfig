## boards/risc-v/ibex-ds/basys3/configs/hello/defconfig
```kconfig
# Arch
CONFIG_ARCH="risc-v"
CONFIG_ARCH_RISCV=y
#
# Board
CONFIG_ARCH_BOARD="basys3"
CONFIG_ARCH_BOARD_BASYS3=y
CONFIG_ARCH_BOARD_COMMON=y
#
# Chip
CONFIG_ARCH_CHIP="ibex-ds"
CONFIG_ARCH_CHIP_IBEX_DS=y
#
# Debug
CONFIG_DEBUG_SYMBOLS=y
CONFIG_RAW_DISASSEMBLY=y
#
# IO
CONFIG_ARCH_LEDS=y
CONFIG_ARCH_LEDS_CPU_ACTIVITY=y
CONFIG_DEV_GPIO=y
CONFIG_DEV_GPIO_NSIGNALS=32
#
# Timer
CONFIG_SYSTEM_TIME64=y
CONFIG_ONESHOT=y
CONFIG_ALARM_ARCH=y
#
# System
CONFIG_HOST_LINUX=y
CONFIG_RAW_BINARY=y
CONFIG_DEFAULT_SMALL=y
CONFIG_RISCV_TOOLCHAIN_GNU_RV32=y
CONFIG_DEV_NULL=n
CONFIG_RAM_SIZE=131072
CONFIG_RAM_START=0x00100000
CONFIG_BOOT_RUNFROMEXTSRAM=y
CONFIG_INIT_STACKSIZE=2048
CONFIG_DEFAULT_TASK_STACKSIZE=2048
CONFIG_IDLETHREAD_STACKSIZE=2048
CONFIG_PTHREAD_STACK_DEFAULT=2048
#
# App
CONFIG_EXAMPLES_HELLO=y
CONFIG_EXAMPLES_HELLO_PROGNAME="hello"
CONFIG_INIT_ENTRYPOINT="hello_main"
CONFIG_EXAMPLES_HELLO_PRIORITY=100
CONFIG_EXAMPLES_HELLO_STACKSIZE=2048
```

## boards/risc-v/ibex-ds/basys3/configs/nsh/defconfig
```kconfig
# Arch
CONFIG_ARCH="risc-v"
CONFIG_ARCH_RISCV=y
#
# Board
CONFIG_ARCH_BOARD="basys3"
CONFIG_ARCH_BOARD_BASYS3=y
CONFIG_ARCH_BOARD_COMMON=y
#
# Chip
CONFIG_ARCH_CHIP="ibex-ds"
CONFIG_ARCH_CHIP_IBEX_DS=y
#
# Debug
CONFIG_DEBUG_SYMBOLS=y
CONFIG_RAW_DISASSEMBLY=y
#
# IO
CONFIG_ARCH_LEDS=y
CONFIG_ARCH_LEDS_CPU_ACTIVITY=y
CONFIG_DEV_GPIO=y
CONFIG_DEV_GPIO_NSIGNALS=32
#
# System
CONFIG_HOST_LINUX=y
CONFIG_RAW_BINARY=y
CONFIG_DEFAULT_SMALL=y
CONFIG_RISCV_TOOLCHAIN_GNU_RV32=y
CONFIG_DEV_NULL=n
CONFIG_RAM_SIZE=131072
CONFIG_RAM_START=0x00100000
CONFIG_BOOT_RUNFROMEXTSRAM=y
CONFIG_INIT_STACKSIZE=2048
CONFIG_DEFAULT_TASK_STACKSIZE=2048
CONFIG_IDLETHREAD_STACKSIZE=2048
CONFIG_PTHREAD_STACK_DEFAULT=2048
# CONFIG_SCHED_TICKLESS=y
#
# Timer
CONFIG_SYSTEM_TIME64=y
CONFIG_ONESHOT=y
CONFIG_ALARM_ARCH=y
#
# App
CONFIG_NSH_LIBRARY=y
CONFIG_SYSTEM_NSH=y
CONFIG_SYSTEM_NSH_PRIORITY=100
CONFIG_SYSTEM_NSH_STACKSIZE=2048
CONFIG_SYSTEM_NSH_PROGNAME="nsh"
CONFIG_INIT_ENTRYPOINT="nsh_main"
CONFIG_INIT_ENTRYNAME="nsh_main"
# CONFIG_SCHED_WAITPID=y
#
CONFIG_NSH_DISABLE_ERROR_PRINT=n
CONFIG_LIBC_STRERROR=y
CONFIG_NSH_STRERROR=y
#
# CONFIG_NSH_DISABLE_BASENAME=n
CONFIG_NSH_DISABLE_CAT=n
#
CONFIG_DISABLE_ENVIRON=n
CONFIG_NSH_DISABLE_CD=n
#
# CONFIG_NSH_DISABLE_CP=n
# CONFIG_NSH_DISABLE_CMP=n
# CONFIG_NSH_DISABLE_DATE=n
# CONFIG_NSH_DISABLE_DD=n
# CONFIG_NSH_DISABLE_DF=n
# CONFIG_NSH_DISABLE_DIRNAME=n
CONFIG_NSH_DISABLE_DMESG=n
# CONFIG_NSH_DISABLE_ECHO=n
# CONFIG_NSH_DISABLE_ENV=n
# CONFIG_NSH_DISABLE_EXEC=n
# CONFIG_NSH_DISABLE_EXPR=n
# CONFIG_NSH_DISABLE_EXPORT=n
#
CONFIG_FS_PROCFS=y
CONFIG_FS_PROCFS_EXCLUDE_MEMINFO=n
CONFIG_NSH_DISABLE_FREE=n
# CONFIG_SCHED_IRQMONITOR=y
#
# CONFIG_NSH_DISABLE_UNAME=n
CONFIG_NSH_DISABLE_UPTIME=n
# CONFIG_NSH_DISABLE_HEXDUMP=n
# CONFIG_NSH_DISABLE_KILL=n
CONFIG_NSH_DISABLE_LS=n
# CONFIG_NSH_DISABLE_MV=n
# CONFIG_NSH_DISABLE_MKDIR=n
# CONFIG_NSH_DISABLE_MB=n
# CONFIG_NSH_DISABLE_MH=n
# CONFIG_NSH_DISABLE_MW=n
# CONFIG_NSH_DISABLE_PRINTF=n
#
CONFIG_FS_PROCFS_EXCLUDE_PROCESS=n
CONFIG_NSH_DISABLE_PS=n
#
# CONFIG_NSH_DISABLE_PWD=n
# CONFIG_NSH_DISABLE_RM=n
# CONFIG_NSH_DISABLE_RMDIR=n
# CONFIG_NSH_DISABLE_SET=n
# CONFIG_NSH_DISABLE_SOURCE=n
CONFIG_NSH_DISABLE_SLEEP=n
# CONFIG_NSH_DISABLE_TIME=n
# CONFIG_NSH_DISABLE_TIMEDATE=nset
# CONFIG_NSH_DISABLE_TEST=n
# CONFIG_NSH_DISABLE_TRUNCATE=n
# CONFIG_NSH_DISABLE_UNSET=n
# CONFIG_NSH_DISABLE_UPTIME=n
# CONFIG_NSH_DISABLE_USLEEP=n
# CONFIG_NSH_DISABLE_XD=n
#
CONFIG_NSH_DISABLE_MOUNT=n
CONFIG_NSH_DISABLE_UMOUNT=n
CONFIG_DISABLE_MOUNTPOINT=n
#
# CONFIG_NSH_DISABLE_MKRD=n
#
# CONFIG_BUILTIN=y
# CONFIG_NSH_BUILTIN_APPS=y
#
# SYSLOG
CONFIG_RAMLOG=y
CONFIG_RAMLOG_SYSLOG=y
CONFIG_RAMLOG_BUFSIZE=2048
```

## boards/risc-v/ibex/basys3/configs/debug/defconfig
```kconfig
# SYSLOG
CONFIG_SYSLOG_DEFAULT=y
#
# Debug logging
CONFIG_DEBUG_FEATURES=y
CONFIG_DEBUG_ERROR=y
CONFIG_DEBUG_WARN=y
CONFIG_DEBUG_INFO=y
CONFIG_DEBUG_ASSERTIONS=y
CONFIG_DEBUG_ASSERTIONS_EXPRESSION=y
CONFIG_DEBUG_ASSERTIONS_FILENAME=y
#
CONFIG_DEBUG_FS=y
CONFIG_DEBUG_FS_ERROR=y
CONFIG_DEBUG_FS_WARN=y
CONFIG_DEBUG_FS_INFO=y
#
CONFIG_DEBUG_LIB=y
CONFIG_DEBUG_LIB_ERROR=y
CONFIG_DEBUG_LIB_WARN=y
CONFIG_DEBUG_LIB_INFO=y
CONFIG_DEBUG_SYS_QUEUE=y
#
CONFIG_DEBUG_MM=y
CONFIG_DEBUG_MM_ERROR=y
CONFIG_DEBUG_MM_WARN=y
CONFIG_DEBUG_MM_INFO=y
#
CONFIG_DEBUG_SYSCALL=y
CONFIG_DEBUG_SYSCALL_ERROR=y
CONFIG_DEBUG_SYSCALL_WARN=y
CONFIG_DEBUG_SYSCALL_INFO=y
#
CONFIG_DEBUG_POWER=y
CONFIG_DEBUG_POWER_ERROR=y
CONFIG_DEBUG_POWER_WARN=y
CONFIG_DEBUG_POWER_INFO=y
#
CONFIG_DEBUG_SCHED=y
CONFIG_DEBUG_SCHED_ERROR=y
CONFIG_DEBUG_SCHED_WARN=y
CONFIG_DEBUG_SCHED_INFO=y
#
CONFIG_DEBUG_IRQ=y
CONFIG_DEBUG_IRQ_ERROR=y
CONFIG_DEBUG_IRQ_WARN=y
CONFIG_DEBUG_IRQ_INFO=y
#
CONFIG_DEBUG_TIMER=y
CONFIG_DEBUG_TIMER_ERROR=y
CONFIG_DEBUG_TIMER_WARN=y
CONFIG_DEBUG_TIMER_INFO=y
#
CONFIG_DEBUG_GPIO=y
CONFIG_DEBUG_GPIO_ERROR=y
CONFIG_DEBUG_GPIO_WARN=y
CONFIG_DEBUG_GPIO_INFO=y
```

## boards/risc-v/ibex/basys3/configs/ostest/defconfig
```kconfig
# Arch
CONFIG_ARCH="risc-v"
CONFIG_ARCH_RISCV=y

# Board
CONFIG_ARCH_BOARD="basys3"
CONFIG_ARCH_BOARD_BASYS3=y
CONFIG_ARCH_BOARD_COMMON=y

# Chip
CONFIG_ARCH_CHIP="ibex"
CONFIG_ARCH_CHIP_IBEX=y

# Debug
# CONFIG_DEBUG_SYMBOLS=y
CONFIG_RAW_DISASSEMBLY=y

# IO
CONFIG_ARCH_LEDS=y
CONFIG_ARCH_LEDS_CPU_ACTIVITY=y
CONFIG_DEV_GPIO=y
CONFIG_DEV_GPIO_NSIGNALS=32

# Timer
CONFIG_SYSTEM_TIME64=y
CONFIG_ONESHOT=y
CONFIG_ALARM_ARCH=y

# System
CONFIG_HOST_LINUX=y
CONFIG_RAW_BINARY=y
CONFIG_DEFAULT_SMALL=y
CONFIG_RISCV_TOOLCHAIN_GNU_RV32=y
CONFIG_DEV_NULL=n
CONFIG_RAM_SIZE=131072
CONFIG_RAM_START=0x00100000
CONFIG_BOOT_RUNFROMEXTSRAM=y
CONFIG_INIT_STACKSIZE=2048
CONFIG_DEFAULT_TASK_STACKSIZE=2048
CONFIG_IDLETHREAD_STACKSIZE=2048
CONFIG_PTHREAD_STACK_DEFAULT=2048

# Customize Header Files
CONFIG_ARCH_SETJMP_H=y

# Stack and heap information
CONFIG_SCHED_EVENTS=y

# RTOS Features
# CONFIG_DISABLE_POSIX_TIMERS=n
CONFIG_DISABLE_PTHREAD=n
CONFIG_DISABLE_MQUEUE=n
CONFIG_DISABLE_ENVIRON=n

# Pthread Options
# CONFIG_PTHREAD_MUTEX_TYPES=y
CONFIG_PTHREAD_MUTEX_ROBUST=y
CONFIG_PTHREAD_MUTEX_DEFAULT_PRIO_NONE=y
# CONFIG_CANCELLATION_POINTS=y

# Thread Local Storage (TLS)
# CONFIG_TLS_ALIGNED is not set
# CONFIG_TLS_NELEM=1
CONFIG_TLS_TASK_NELEM=0
# CONFIG_TLS_NCLEANUP=1

# Files and I/O
CONFIG_FILE_STREAM=y

# File system configuration
# CONFIG_FS_NAMED_SEMAPHORES=y

# Tasks and Scheduling
# CONFIG_SCHED_WAITPID=y
# CONFIG_SCHED_HAVE_PARENT=y
# CONFIG_SIG_SIGSTOP_ACTION=y
# CONFIG_SIG_SIGKILL_ACTION=y
# CONFIG_SIG_EVTHREAD=y # only flat build
# CONFIG_RR_INTERVAL=1
# CONFIG_SCHED_SPORADIC=y

# App
CONFIG_INIT_ENTRYPOINT="ostest_main"
CONFIG_TESTING_OSTEST=y
CONFIG_TESTING_OSTEST_LOOPS=1
CONFIG_TESTING_OSTEST_STACKSIZE=8192
CONFIG_TESTING_OSTEST_NBARRIER_THREADS=8
CONFIG_TESTING_OSTEST_RR_RANGE=10000
CONFIG_TESTING_OSTEST_RR_RUNS=1
CONFIG_TESTING_OSTEST_FPUTESTDISABLE=y
```

## boards/risc-v/ibex/nexys-video/configs/ostest/defconfig
```kconfig
# Build Setup
CONFIG_HOST_LINUX=y
# CONFIG_DEFAULT_SMALL=y

# System Type
CONFIG_ARCH="risc-v"
CONFIG_ARCH_RISCV=y
CONFIG_ARCH_CHIP="ibex"

# Boot options
CONFIG_BOOT_RUNFROMEXTSRAM=y

# Boot Memory Configuration
CONFIG_RAM_START=0x00100000
CONFIG_RAM_SIZE=524288

# Board Selection
CONFIG_ARCH_BOARD="nexys-video"
CONFIG_ARCH_BOARD_NEXYS_VIDEO=y

# Board-Common Options
CONFIG_ARCH_BOARD_COMMON=y

# RISC-V Options
CONFIG_ARCH_CHIP_IBEX=y
CONFIG_RISCV_TOOLCHAIN_GNU_RV32=y

# Debug Options
# CONFIG_DEBUG_SYMBOLS=y

# Binary Output Formats
CONFIG_RAW_DISASSEMBLY=y
CONFIG_RAW_BINARY=y

# Common Board Options
CONFIG_ARCH_LEDS=y
CONFIG_ARCH_LEDS_CPU_ACTIVITY=y

# IO Expander/GPIO Support
CONFIG_DEV_GPIO=y
CONFIG_DEV_GPIO_NSIGNALS=32

# Clocks and Timers
CONFIG_SYSTEM_TIME64=y

# Timer Driver Support
CONFIG_ONESHOT=y
CONFIG_ALARM_ARCH=y

# Customize Header Files
CONFIG_ARCH_SETJMP_H=y

# Stack and heap information
CONFIG_SCHED_EVENTS=y
CONFIG_DEFAULT_TASK_STACKSIZE=2048
CONFIG_IDLETHREAD_STACKSIZE=2048
CONFIG_PTHREAD_STACK_DEFAULT=2048

# RTOS Features
CONFIG_DISABLE_POSIX_TIMERS=n
CONFIG_DISABLE_PTHREAD=n
CONFIG_DISABLE_MQUEUE=n
CONFIG_DISABLE_ENVIRON=n
CONFIG_DEV_NULL=n

# Pthread Options
CONFIG_PTHREAD_MUTEX_TYPES=y
CONFIG_PTHREAD_MUTEX_ROBUST=y
CONFIG_PTHREAD_MUTEX_DEFAULT_PRIO_NONE=y
CONFIG_CANCELLATION_POINTS=y

# Thread Local Storage (TLS)
# CONFIG_TLS_ALIGNED=y
CONFIG_TLS_NELEM=4
CONFIG_TLS_TASK_NELEM=4
CONFIG_TLS_NCLEANUP=4

# Files and I/O
CONFIG_FILE_STREAM=y

# File system configuration
CONFIG_FS_NAMED_SEMAPHORES=y

# Tasks and Scheduling
CONFIG_INIT_STACKSIZE=2048
CONFIG_INIT_ENTRYPOINT="ostest_main"
CONFIG_SCHED_WAITPID=y
CONFIG_SCHED_HAVE_PARENT=y
CONFIG_SIG_SIGSTOP_ACTION=y
CONFIG_SIG_SIGKILL_ACTION=y
CONFIG_SIG_EVTHREAD=y # only flat build
CONFIG_RR_INTERVAL=200
# CONFIG_SCHED_SPORADIC=y

# Testing
CONFIG_TESTING_OSTEST=y
CONFIG_TESTING_OSTEST_LOOPS=1
CONFIG_TESTING_OSTEST_STACKSIZE=8192
CONFIG_TESTING_OSTEST_NBARRIER_THREADS=8
CONFIG_TESTING_OSTEST_RR_RANGE=10000
CONFIG_TESTING_OSTEST_RR_RUNS=1
CONFIG_TESTING_OSTEST_FPUTESTDISABLE=y
```
